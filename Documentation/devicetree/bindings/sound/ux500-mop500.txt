## Documentation/devicetree/bindings/sound/ux500-mop500.txt
```
* MOP500 Audio Machine Driver

This node is responsible for linking together all ux500 Audio Driver components.

Required properties:
 - compatible              : "stericsson,snd-soc-mop500"

Non-standard properties:
 - stericsson,card-name    : Over-ride default card name

Example:

	sound {
		compatible = "stericsson,snd-soc-mop500";

		ab8500-codec-playback-dai-link@0 {
			link-name = "AB8500 codec playback";
			cpu {
				sound-dai = <&msp1>;
			};
			codec {
				sound-dai = <&codec>;
			};
		};
		ab8500-codec-record-dai-link@0 {
			link-name = "AB8500 codec record";
			cpu {
				sound-dai = <&msp3>;
			};
			codec {
				sound-dai = <&codec>;
			};
		};
	};

	msp1: msp@80124000 {
		compatible = "stericsson,ux500-msp-i2s";
		reg = <0x80124000 0x1000>;
		interrupts = <0 62 0x4>;
		v-ape-supply = <&db8500_vape_reg>;
	};

	msp3: msp@80125000 {
		compatible = "stericsson,ux500-msp-i2s";
		reg = <0x80125000 0x1000>;
		interrupts = <0 62 0x4>;
		v-ape-supply = <&db8500_vape_reg>;
	};

	codec: ab8500-codec {
		compatible = "stericsson,ab8500-codec";
		stericsson,earpeice-cmv = <950>; /* Units in mV. */
	};
```

## arch/arm/test/Kconfig
```kconfig
config ARM_TEST
       bool "Enable ARM kernel tests"

if ARM_TEST

menu "ARM Kernel tests"

comment "test code to exercise the ARM kernel"

config ARM_TCM_TEST
	bool "ARM TCM test"
	depends on HAVE_TCM
	help
		Enables some test code snippets to exercise the TCM memory
		on platforms that have it. The code will not be executed
		if no TCM memory is found.

endmenu

endif
```
